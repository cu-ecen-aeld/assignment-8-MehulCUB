## base_external/package/aesdchardriver/Config.in
```kconfig
config BR2_PACKAGE_AESDCHARDRIVER
	bool "aesdchardriver"
	help
	  Includes the AESD Chardriver Package
```

## base_external/package/ldd/Config.in
```kconfig
config BR2_PACKAGE_LDD
	bool "ldd"
	help
	  Includes the scull load, unload,and module load, unload in the kernel image.
	  Used to understand buildroot external trees and package builds.
```
